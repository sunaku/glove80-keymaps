//////////////////////////////////////////////////////////////////////
// NOTE: Use the `#define` settings below to customize this keymap! //
//////////////////////////////////////////////////////////////////////
// IMPORTANT: You need to set Firmware Version to "pr19.zephyr-3-2" //
// under Settings > Advanced Settings in the Glove80 Layout Editor  //
// if you want to use the `hold-trigger-on-release` feature in ZMK. //
//////////////////////////////////////////////////////////////////////
// CAUTION: PR19 firmware is not production quality; it has issues: //
// https://discord.com/channels/877392805654306816/1137025078979203142
//////////////////////////////////////////////////////////////////////
//
// Sunaku's Keymap v25 featuring Arno's Engram 2.0 layout with Miryoku
// - https://github.com/sunaku/glove80-keymaps
//
//////////////////////////////////////////////////////////////////////

behaviors {

    //////////////////////////////////////////////////////////////////
    //
    // Miryoku layers and home row mods (ported from my QMK endgame)
    // - https://sunaku.github.io/home-row-mods.html#porting-to-zmk
    // - https://github.com/urob/zmk-config#timeless-homerow-mods
    //
    //////////////////////////////////////////////////////////////////

    //
    // HOMEY_HOLDING_TYPE defines the flavor of ZMK hold-tap behavior to use
    // for the pinky, ring, and middle fingers (which are assigned to Super,
    // Alt, and Ctrl respectively in the Miryoku system) on home row keys.
    //
    #define HOMEY_HOLDING_TYPE "tap-preferred"

    //
    // HOMEY_HOLDING_TIME defines how long you need to hold (milliseconds)
    // home row mod keys in order to send their modifiers to the computer
    // (i.e. "register" them) for mod-click mouse usage (e.g. Ctrl-Click).
    //
    #define HOMEY_HOLDING_TIME 270 // TAPPING_TERM + ALLOW_CROSSOVER_AFTER

    //
    // HOMEY_STREAK_DECAY defines how long you need to wait (milliseconds)
    // after typing before you can use home row mods again.  It prevents
    // unintended activation of home row mods when you're actively typing.
    //
    #define HOMEY_STREAK_DECAY 170 // global-quick-tap-ms

    //
    // SHIFT_HOLDING_TYPE defines the flavor of ZMK hold-tap behavior to use
    // for index fingers (which Miryoku assigns to Shift) on home row keys.
    //
    // NOTE: The "tap-preferred" flavor of ZMK hold-tap for index finger keys
    // allows faster activation of the Shift modifier (without having to wait
    // for the modified key to be released as the "balanced" flavor requires).
    // Typing streaks and the `hold-trigger-on-release` setting are disabled
    // for the index fingers so as not to hinder their speed and dexterity.
    //
    #define SHIFT_HOLDING_TYPE "tap-preferred"

    //
    // SHIFT_HOLDING_TIME defines how long you need to hold (milliseconds)
    // index finger keys in order to send their modifiers to the computer
    // (i.e. "register" them) for mod-click mouse usage (e.g. Shift-Click).
    //
    // CAUTION: You'll need to perform inward rolls from pinky->ring->middle
    // fingers toward the index fingers when activating multiple modifiers
    // because `hold-trigger-on-release` is disabled for the index fingers.
    // Otherwise, you may be surprised that the index fingers' modifier is
    // sent immediately without the rest of your multi-mod chord when you
    // perform outward rolls from your index fingers toward your pinkies.
    //
    #define SHIFT_HOLDING_TIME 170

    //
    // SHIFT_STREAK_DECAY defines how long you need to wait (milliseconds)
    // after typing before you can use home row mods again.  It prevents
    // unintended activation of home row mods when you're actively typing.
    //
    #define SHIFT_STREAK_DECAY 70 // global-quick-tap-ms

    //
    // THUMB_HOLDING_TYPE defines the flavor of ZMK hold-tap behavior to use
    // for the thumbs (which are assigned to 6 layers in the Miryoku system).
    //
    // NOTE: The "balanced" flavor of ZMK hold-tap provides instant modifier
    // activation for the symbol layer (if the tapped symbol key is released
    // while the thumb layer key is still held down) for quicker programming.
    //
    #define THUMB_HOLDING_TYPE "balanced"

    //
    // THUMB_HOLDING_TIME defines how long you need to hold (milliseconds)
    // a thumb key to activate a layer.  Shorter holds are treated as taps.
    //
    #define THUMB_HOLDING_TIME 200

    //
    // THUMB_REPEAT_DECAY defines how much time you have left (milliseconds)
    // after tapping a key to hold it again in order to make it auto-repeat.
    //
    #define THUMB_REPEAT_DECAY 300 // "tap then hold" for key auto-repeat

    //
    // SPACE_HOLDING_TIME defines how long you need to hold (milliseconds)
    // the space thumb key to activate.  Shorter holds are treated as taps.
    //
    #define SPACE_HOLDING_TIME 170

    //
    // SPACE_REPEAT_DECAY defines how much time you have left (milliseconds)
    // after tapping a key to hold it again in order to make it auto-repeat.
    //
    #define SPACE_REPEAT_DECAY 200 // "tap then hold" for key auto-repeat

    //
    // Glove80 key positions index for positional hold-tap
    // - https://discord.com/channels/877392805654306816/937645688244826154/1066713913351221248
    // - https://media.discordapp.net/attachments/937645688244826154/1066713913133121556/image.png
    //
    // |------------------------|------------------------|
    // | LEFT_HAND_KEYS         |        RIGHT_HAND_KEYS |
    // |                        |                        |
    // |  0  1  2  3  4         |          5  6  7  8  9 |
    // | 10 11 12 13 14 15      |      16 17 18 19 20 21 |
    // | 22 23 24 25 26 27      |      28 29 30 31 32 33 |
    // | 34 35 36 37 38 39      |      40 41 42 43 44 45 |
    // | 46 47 48 49 50 51      |      58 59 60 61 62 63 |
    // | 64 65 66 67 68         |         75 76 77 78 79 |
    // |                69 52   |   57 74                |
    // |                 70 53  |  56 73                 |
    // |                  71 54 | 55 72                  |
    // |------------------------|------------------------|
    //
    #define LEFT_HAND_KEYS      \
          0  1  2  3  4         \
         10 11 12 13 14 15      \
         22 23 24 25 26 27      \
         34 35 36 37 38 39      \
         46 47 48 49 50 51      \
         64 65 66 67 68
    #define RIGHT_HAND_KEYS     \
                                           5  6  7  8  9 \
                                       16 17 18 19 20 21 \
                                       28 29 30 31 32 33 \
                                       40 41 42 43 44 45 \
                                       58 59 60 61 62 63 \
                                          75 76 77 78 79
    #define THUMB_KEYS          \
                        69 52       57 74                \
                         70 53     56 73                 \
                          71 54   55 72

    //
    // Home row mod-tap keys for all except index fingers
    //
    homey_left: miryoku_home_row_mods_left_hand {
        compatible = "zmk,behavior-hold-tap";
        label = "HOME_ROW_MODS_LEFT_HAND";
        flavor = HOMEY_HOLDING_TYPE;
        hold-trigger-key-positions = <RIGHT_HAND_KEYS THUMB_KEYS>;
        hold-trigger-on-release; // wait for other home row mods
        tapping-term-ms = <HOMEY_HOLDING_TIME>;
        quick-tap-ms = <HOMEY_STREAK_DECAY>;
        global-quick-tap; // with typing streak
        #binding-cells = <2>;
        bindings = <&kp>, <&kp>;
    };
    homey_right: miryoku_home_row_mods_right_hand {
        compatible = "zmk,behavior-hold-tap";
        label = "HOME_ROW_MODS_RIGHT_HAND";
        flavor = HOMEY_HOLDING_TYPE;
        hold-trigger-key-positions = <LEFT_HAND_KEYS THUMB_KEYS>;
        hold-trigger-on-release; // wait for other home row mods
        tapping-term-ms = <HOMEY_HOLDING_TIME>;
        quick-tap-ms = <HOMEY_STREAK_DECAY>;
        global-quick-tap; // with typing streak
        #binding-cells = <2>;
        bindings = <&kp>, <&kp>;
    };

    //
    // Special home row mod-tap keys for the index fingers
    //
    shift_left: miryoku_home_row_mods_left_shift_shift {
        compatible = "zmk,behavior-hold-tap";
        label = "HOME_ROW_MODS_LEFT_SHIFT_SHIFT";
        flavor = SHIFT_HOLDING_TYPE;
        hold-trigger-key-positions = <RIGHT_HAND_KEYS THUMB_KEYS>;
        //hold-trigger-on-release; // don't wait for other mods
        tapping-term-ms = <SHIFT_HOLDING_TIME>;
        quick-tap-ms = <SHIFT_STREAK_DECAY>;
        global-quick-tap; // with typing streak
        #binding-cells = <2>;
        bindings = <&kp>, <&kp>;
    };
    shift_right: miryoku_home_row_mods_right_shift_shift {
        compatible = "zmk,behavior-hold-tap";
        label = "HOME_ROW_MODS_RIGHT_SHIFT_SHIFT";
        flavor = SHIFT_HOLDING_TYPE;
        hold-trigger-key-positions = <LEFT_HAND_KEYS THUMB_KEYS>;
        //hold-trigger-on-release; // don't wait for other mods
        tapping-term-ms = <SHIFT_HOLDING_TIME>;
        quick-tap-ms = <SHIFT_STREAK_DECAY>;
        global-quick-tap; // with typing streak
        #binding-cells = <2>;
        bindings = <&kp>, <&kp>;
    };

    //
    // Thumb cluster hold-tap keys for Miryoku layers
    //
    thumb: miryoku_thumb_layer {
        compatible = "zmk,behavior-hold-tap";
        label = "MIRYOKU_THUMB_LAYER";
        flavor = THUMB_HOLDING_TYPE;
        tapping-term-ms = <THUMB_HOLDING_TIME>;
        quick-tap-ms = <THUMB_REPEAT_DECAY>; // enable repeat
        //global-quick-tap; // no typing streak
        //retro-tap; // don't allow slow (hold-like) taps
        #binding-cells = <2>;
        bindings = <&mo>, <&kp>;
    };
    space: miryoku_thumb_layer_spacebar {
        compatible = "zmk,behavior-hold-tap";
        label = "MIRYOKU_THUMB_LAYER_SPACEBAR";
        flavor = THUMB_HOLDING_TYPE;
        tapping-term-ms = <SPACE_HOLDING_TIME>;
        quick-tap-ms = <SPACE_REPEAT_DECAY>; // enable repeat
        //global-quick-tap; // no typing streak
        retro-tap; // allow slow (hold-like) taps
        #binding-cells = <2>;
        bindings = <&mo>, <&kp>;
    };

    //////////////////////////////////////////////////////////////////
    //
    // Custom shifted pairs
    //
    //////////////////////////////////////////////////////////////////

    //
    // Shift + CapsWord = CapsLock
    //
    cappy: capsword_and_capslock {
        compatible = "zmk,behavior-mod-morph";
        label = "CAPSWORD_AND_CAPSLOCK";
        #binding-cells = <0>;
        bindings = <&caps_word>, <&kp CAPSLOCK>;
        mods = <(MOD_LSFT|MOD_RSFT)>;
    };

    //
    // Custom shifted pairs for the Engram layout
    // - https://engram.dev/
    // - https://sunaku.github.io/engram-keyboard-layout.html
    //
    engram_1: engram_one_and_pipe {
        compatible = "zmk,behavior-mod-morph";
        label = "ENGRAM_ONE_AND_PIPE";
        #binding-cells = <0>;
        bindings = <&kp N1>, <&kp PIPE>;
        mods = <(MOD_LSFT|MOD_RSFT)>;
    };
    engram_2: engram_two_and_equal {
        compatible = "zmk,behavior-mod-morph";
        label = "ENGRAM_TWO_AND_EQUAL";
        #binding-cells = <0>;
        bindings = <&kp N2>, <&kp EQUAL>;
        mods = <(MOD_LSFT|MOD_RSFT)>;
    };
    engram_3: engram_three_and_tilde {
        compatible = "zmk,behavior-mod-morph";
        label = "ENGRAM_THREE_AND_TILDE";
        #binding-cells = <0>;
        bindings = <&kp N3>, <&kp TILDE>;
        mods = <(MOD_LSFT|MOD_RSFT)>;
    };
    engram_4: engram_four_and_plus {
        compatible = "zmk,behavior-mod-morph";
        label = "ENGRAM_FOUR_AND_PLUS";
        #binding-cells = <0>;
        bindings = <&kp N4>, <&kp PLUS>;
        mods = <(MOD_LSFT|MOD_RSFT)>;
    };
    engram_5: engram_five_and_less_than {
        compatible = "zmk,behavior-mod-morph";
        label = "ENGRAM_FIVE_AND_LESS_THAN";
        #binding-cells = <0>;
        bindings = <&kp N5>, <&kp LESS_THAN>;
        mods = <(MOD_LSFT|MOD_RSFT)>;
    };
    engram_6: engram_six_and_greater_than {
        compatible = "zmk,behavior-mod-morph";
        label = "ENGRAM_SIX_AND_GREATER_THAN";
        #binding-cells = <0>;
        bindings = <&kp N6>, <&kp GREATER_THAN>;
        mods = <(MOD_LSFT|MOD_RSFT)>;
    };
    engram_7: engram_seven_and_caret {
        compatible = "zmk,behavior-mod-morph";
        label = "ENGRAM_SEVEN_AND_CARET";
        #binding-cells = <0>;
        bindings = <&kp N7>, <&kp CARET>;
        mods = <(MOD_LSFT|MOD_RSFT)>;
    };
    engram_8: engram_eight_and_ampersand {
        compatible = "zmk,behavior-mod-morph";
        label = "ENGRAM_EIGHT_AND_AMPERSAND";
        #binding-cells = <0>;
        bindings = <&kp N8>, <&kp AMPERSAND>;
        mods = <(MOD_LSFT|MOD_RSFT)>;
    };
    engram_9: engram_nine_and_percent {
        compatible = "zmk,behavior-mod-morph";
        label = "ENGRAM_NINE_AND_PERCENT";
        #binding-cells = <0>;
        bindings = <&kp N9>, <&kp PERCENT>;
        mods = <(MOD_LSFT|MOD_RSFT)>;
    };
    engram_0: engram_zero_and_asterisk {
        compatible = "zmk,behavior-mod-morph";
        label = "ENGRAM_ZERO_AND_ASTERISK";
        #binding-cells = <0>;
        bindings = <&kp N0>, <&kp ASTERISK>;
        mods = <(MOD_LSFT|MOD_RSFT)>;
    };
    engram_apos: engram_apostrophe_and_left_parenthesis {
        compatible = "zmk,behavior-mod-morph";
        label = "ENGRAM_APOSTROPHE_AND_LEFT_PARENTHESIS";
        #binding-cells = <0>;
        bindings = <&kp APOSTROPHE>, <&kp LEFT_PARENTHESIS>;
        mods = <(MOD_LSFT|MOD_RSFT)>;
    };
    engram_dquote: engram_double_quotes_and_right_parenthesis {
        compatible = "zmk,behavior-mod-morph";
        label = "ENGRAM_DOUBLE_QUOTES_AND_RIGHT_PARENTHESIS";
        #binding-cells = <0>;
        bindings = <&kp DOUBLE_QUOTES>, <&kp RIGHT_PARENTHESIS>;
        mods = <(MOD_LSFT|MOD_RSFT)>;
    };
    engram_comma: engram_comma_and_semicolon {
        compatible = "zmk,behavior-mod-morph";
        label = "ENGRAM_COMMA_AND_SEMICOLON";
        #binding-cells = <0>;
        bindings = <&kp COMMA>, <&kp SEMICOLON>;
        mods = <(MOD_LSFT|MOD_RSFT)>;
    };
    engram_period: engram_period_and_colon {
        compatible = "zmk,behavior-mod-morph";
        label = "ENGRAM_PERIOD_AND_COLON";
        #binding-cells = <0>;
        bindings = <&kp PERIOD>, <&kp COLON>;
        mods = <(MOD_LSFT|MOD_RSFT)>;
    };
    engram_question: engram_question_and_exclamation {
        compatible = "zmk,behavior-mod-morph";
        label = "ENGRAM_QUESTION_AND_EXCLAMATION";
        #binding-cells = <0>;
        bindings = <&kp QUESTION>, <&kp EXCLAMATION>;
        mods = <(MOD_LSFT|MOD_RSFT)>;
    };
    engram_hash: engram_hash_and_dollar {
        compatible = "zmk,behavior-mod-morph";
        label = "ENGRAM_HASH_AND_DOLLAR";
        #binding-cells = <0>;
        bindings = <&kp HASH>, <&kp DOLLAR>;
        mods = <(MOD_LSFT|MOD_RSFT)>;
    };
    engram_at: engram_at_and_grave {
        compatible = "zmk,behavior-mod-morph";
        label = "ENGRAM_AT_AND_GRAVE";
        #binding-cells = <0>;
        bindings = <&kp AT>, <&kp GRAVE>;
        mods = <(MOD_LSFT|MOD_RSFT)>;
    };
    engram_slash: engram_slash_and_backslash {
        compatible = "zmk,behavior-mod-morph";
        label = "ENGRAM_SLASH_AND_BACKSLASH";
        #binding-cells = <0>;
        bindings = <&kp SLASH>, <&kp BACKSLASH>;
        mods = <(MOD_LSFT|MOD_RSFT)>;
    };

    //////////////////////////////////////////////////////////////////
    //
    // ZMK global overrides
    //
    //////////////////////////////////////////////////////////////////

    //
    // CapsWord - ported from Pascal Getreuer's extension for QMK
    // - https://zmk.dev/docs/behaviors/caps-word
    // - https://getreuer.info/posts/keyboards/caps-word/index.html
    //
    behavior_caps_word {
        continue-list = <
            UNDERSCORE MINUS
            BACKSPACE DELETE
            N1 N2 N3 N4 N5 N6 N7 N8 N9 N0
        >;
    };

};

macros {

    //////////////////////////////////////////////////////////////////
    //
    // Approximation of Pascal Getreuer's Select Word macro from QMK
    // - https://getreuer.info/posts/keyboards/select-word/index.html
    //
    //////////////////////////////////////////////////////////////////

    //
    // SELECT_WORD_DELAY defines how long the macro waits (milliseconds)
    // after moving the cursor before it selects a word.  A larger delay
    // may allow the macro to move to the next word upon each invocation.
    //
    #define SELECT_WORD_DELAY 1

    //
    // select a word (jumps to next word upon each successive invocation)
    //
    select_word: select_word {
        compatible = "zmk,behavior-mod-morph";
        label = "SELECT_WORD";
        #binding-cells = <0>;
        bindings = <&select_word_right>, <&select_word_left>;
        mods = <(MOD_LSFT|MOD_RSFT)>;
    };
    ZMK_MACRO(select_word_right,
        wait-ms = <SELECT_WORD_DELAY>;
        tap-ms = <SELECT_WORD_DELAY>;
        bindings = <&kp LC(RIGHT) &kp LC(LEFT) &kp LC(LS(RIGHT))>;
    )
    ZMK_MACRO(select_word_left,
        wait-ms = <SELECT_WORD_DELAY>;
        tap-ms = <SELECT_WORD_DELAY>;
        bindings = <&kp LC(LEFT) &kp LC(RIGHT) &kp LC(LS(LEFT))>;
    )

    //
    // extend current selection by one word
    //
    extend_word: extend_word {
        compatible = "zmk,behavior-mod-morph";
        label = "EXTEND_WORD";
        #binding-cells = <0>;
        bindings = <&extend_word_right>, <&extend_word_left>;
        mods = <(MOD_LSFT|MOD_RSFT)>;
    };
    ZMK_MACRO(extend_word_right,
        wait-ms = <SELECT_WORD_DELAY>;
        tap-ms = <SELECT_WORD_DELAY>;
        bindings = <&kp LC(LS(RIGHT))>;
    )
    ZMK_MACRO(extend_word_left,
        wait-ms = <SELECT_WORD_DELAY>;
        tap-ms = <SELECT_WORD_DELAY>;
        bindings = <&kp LC(LS(LEFT))>;
    )

    //
    // select current line
    //
    select_line: select_line {
        compatible = "zmk,behavior-mod-morph";
        label = "SELECT_LINE";
        #binding-cells = <0>;
        bindings = <&select_line_right>, <&select_line_left>;
        mods = <(MOD_LSFT|MOD_RSFT)>;
    };
    ZMK_MACRO(select_line_right,
        wait-ms = <SELECT_WORD_DELAY>;
        tap-ms = <SELECT_WORD_DELAY>;
        bindings = <&kp HOME &kp LS(END)>;
    )
    ZMK_MACRO(select_line_left,
        wait-ms = <SELECT_WORD_DELAY>;
        tap-ms = <SELECT_WORD_DELAY>;
        bindings = <&kp END &kp LS(HOME)>;
    )

    //
    // extend current selection by one line
    //
    extend_line: extend_line {
        compatible = "zmk,behavior-mod-morph";
        label = "EXTEND_LINE";
        #binding-cells = <0>;
        bindings = <&extend_line_right>, <&extend_line_left>;
        mods = <(MOD_LSFT|MOD_RSFT)>;
    };
    ZMK_MACRO(extend_line_right,
        wait-ms = <SELECT_WORD_DELAY>;
        tap-ms = <SELECT_WORD_DELAY>;
        bindings = <&kp LS(DOWN) &kp LS(END)>;
    )
    ZMK_MACRO(extend_line_left,
        wait-ms = <SELECT_WORD_DELAY>;
        tap-ms = <SELECT_WORD_DELAY>;
        bindings = <&kp LS(UP) &kp LS(HOME)>;
    )

    //////////////////////////////////////////////////////////////////////////
    //
    // World layer - international characters
    //
    //////////////////////////////////////////////////////////////////////////

    //
    // UNICODE_TAP_DELAY defines how long the macro waits (milliseconds)
    // between keystrokes while inputting the Unicode codepoint shortcut.
    //
    #define UNICODE_TAP_DELAY 1

    //
    // UNICODE_SEQ_DELAY defines how long the macro waits (milliseconds)
    // between emitting Unicode codepoints in multi-codepoint characters.
    //
    #define UNICODE_SEQ_DELAY 10

    //
    // UNICODE_TRANSLATE() defines how a textual codepoint will be converted
    // into an actual Unicode codepoint.  This is Operating System dependent.
    //
    #define UNICODE_TRANSLATE(codepoint) \
        UNICODE_TRANSLATE_LINUX(codepoint) // you can change this to WINDOWS

    #define UNICODE_TRANSLATE_LINUX(codepoint) \
                <&kp LC(LS(U))> \
                , codepoint \
                , <&kp ENTER>

    #define UNICODE_TRANSLATE_WINDOWS(codepoint) \
                codepoint \
                , <&kp LA(X)>

    #define UNICODE_SEQUENCE(name, ...) \
        ZMK_MACRO(name, \
            wait-ms = <UNICODE_TAP_DELAY>; \
            tap-ms = <UNICODE_TAP_DELAY>; \
            bindings = __VA_ARGS__; \
        )

    #define UNICODE(name, codepoint) \
        UNICODE_SEQUENCE(name, UNICODE_TRANSLATE(codepoint))

    UNICODE(world_degree_sign,       <&kp N0 &kp N0 &kp B  &kp N0 >) // °
    UNICODE(world_section_sign,      <&kp N0 &kp N0 &kp A  &kp N7 >) // §
    UNICODE(world_paragraph_sign,    <&kp N0 &kp N0 &kp B  &kp N6 >) // ¶
    UNICODE(world_o_ordinal,         <&kp N0 &kp N0 &kp B  &kp A  >) // º
    UNICODE(world_a_ordinal,         <&kp N0 &kp N0 &kp A  &kp A  >) // ª
    UNICODE(world_exclaim_left,      <&kp N0 &kp N0 &kp A  &kp N1 >) // ¡
    UNICODE(world_question_left,     <&kp N0 &kp N0 &kp B  &kp F  >) // ¿
    UNICODE(world_quote_left,        <&kp N0 &kp N0 &kp A  &kp B  >) // «
    UNICODE(world_quote_right,       <&kp N0 &kp N0 &kp B  &kp B  >) // »

      // characters //////////////////////////////////////////////////////////

          /* ç */ UNICODE(world_c_cedilla_lower, <&kp N0 &kp N0 &kp E &kp N7>)

          /* Ç */ UNICODE(world_c_cedilla_upper, <&kp N0 &kp N0 &kp C &kp N7>)

        world_c_cedilla: world_c_cedilla {
            compatible = "zmk,behavior-mod-morph";
            label = "WORLD_C_CEDILLA";
            #binding-cells = <0>;
            bindings = <&world_c_cedilla_lower>, <&world_c_cedilla_upper>;
            mods = <MOD_LSFT>;
        };

          /* í */ UNICODE(world_i_acute_lower, <&kp N0 &kp N0 &kp E &kp D>)

          /* Í */ UNICODE(world_i_acute_upper, <&kp N0 &kp N0 &kp C &kp D>)

        world_i_acute: world_i_acute {
            compatible = "zmk,behavior-mod-morph";
            label = "WORLD_I_ACUTE";
            #binding-cells = <0>;
            bindings = <&world_i_acute_lower>, <&world_i_acute_upper>;
            mods = <MOD_LSFT>;
        };

          /* ï */ UNICODE(world_i_diaeresis_lower, <&kp N0 &kp N0 &kp E &kp F>)

          /* Ï */ UNICODE(world_i_diaeresis_upper, <&kp N0 &kp N0 &kp C &kp F>)

        world_i_diaeresis: world_i_diaeresis {
            compatible = "zmk,behavior-mod-morph";
            label = "WORLD_I_DIAERESIS";
            #binding-cells = <0>;
            bindings = <&world_i_diaeresis_lower>, <&world_i_diaeresis_upper>;
            mods = <MOD_LSFT>;
        };

          /* î */ UNICODE(world_i_circumflex_lower, <&kp N0 &kp N0 &kp E &kp E>)

          /* Î */ UNICODE(world_i_circumflex_upper, <&kp N0 &kp N0 &kp C &kp E>)

        world_i_circumflex: world_i_circumflex {
            compatible = "zmk,behavior-mod-morph";
            label = "WORLD_I_CIRCUMFLEX";
            #binding-cells = <0>;
            bindings = <&world_i_circumflex_lower>, <&world_i_circumflex_upper>;
            mods = <MOD_LSFT>;
        };

          /* ì */ UNICODE(world_i_grave_lower, <&kp N0 &kp N0 &kp E &kp C>)

          /* Ì */ UNICODE(world_i_grave_upper, <&kp N0 &kp N0 &kp C &kp C>)

        world_i_grave: world_i_grave {
            compatible = "zmk,behavior-mod-morph";
            label = "WORLD_I_GRAVE";
            #binding-cells = <0>;
            bindings = <&world_i_grave_lower>, <&world_i_grave_upper>;
            mods = <MOD_LSFT>;
        };

          /* é */ UNICODE(world_e_acute_lower, <&kp N0 &kp N0 &kp E &kp N9>)

          /* É */ UNICODE(world_e_acute_upper, <&kp N0 &kp N0 &kp C &kp N9>)

        world_e_acute: world_e_acute {
            compatible = "zmk,behavior-mod-morph";
            label = "WORLD_E_ACUTE";
            #binding-cells = <0>;
            bindings = <&world_e_acute_lower>, <&world_e_acute_upper>;
            mods = <MOD_LSFT>;
        };

          /* ë */ UNICODE(world_e_diaeresis_lower, <&kp N0 &kp N0 &kp E &kp B>)

          /* Ë */ UNICODE(world_e_diaeresis_upper, <&kp N0 &kp N0 &kp C &kp B>)

        world_e_diaeresis: world_e_diaeresis {
            compatible = "zmk,behavior-mod-morph";
            label = "WORLD_E_DIAERESIS";
            #binding-cells = <0>;
            bindings = <&world_e_diaeresis_lower>, <&world_e_diaeresis_upper>;
            mods = <MOD_LSFT>;
        };

          /* ê */ UNICODE(world_e_circumflex_lower, <&kp N0 &kp N0 &kp E &kp A>)

          /* Ê */ UNICODE(world_e_circumflex_upper, <&kp N0 &kp N0 &kp C &kp A>)

        world_e_circumflex: world_e_circumflex {
            compatible = "zmk,behavior-mod-morph";
            label = "WORLD_E_CIRCUMFLEX";
            #binding-cells = <0>;
            bindings = <&world_e_circumflex_lower>, <&world_e_circumflex_upper>;
            mods = <MOD_LSFT>;
        };

          /* è */ UNICODE(world_e_grave_lower, <&kp N0 &kp N0 &kp E &kp N8>)

          /* È */ UNICODE(world_e_grave_upper, <&kp N0 &kp N0 &kp C &kp N8>)

        world_e_grave: world_e_grave {
            compatible = "zmk,behavior-mod-morph";
            label = "WORLD_E_GRAVE";
            #binding-cells = <0>;
            bindings = <&world_e_grave_lower>, <&world_e_grave_upper>;
            mods = <MOD_LSFT>;
        };

          /* æ */ UNICODE(world_e_ae_lower, <&kp N0 &kp N0 &kp E &kp N6>)

          /* Æ */ UNICODE(world_e_ae_upper, <&kp N0 &kp N0 &kp C &kp N6>)

        world_e_ae: world_e_ae {
            compatible = "zmk,behavior-mod-morph";
            label = "WORLD_E_AE";
            #binding-cells = <0>;
            bindings = <&world_e_ae_lower>, <&world_e_ae_upper>;
            mods = <MOD_LSFT>;
        };

          /* á */ UNICODE(world_a_acute_lower, <&kp N0 &kp N0 &kp E &kp N1>)

          /* Á */ UNICODE(world_a_acute_upper, <&kp N0 &kp N0 &kp C &kp N1>)

        world_a_acute: world_a_acute {
            compatible = "zmk,behavior-mod-morph";
            label = "WORLD_A_ACUTE";
            #binding-cells = <0>;
            bindings = <&world_a_acute_lower>, <&world_a_acute_upper>;
            mods = <MOD_LSFT>;
        };

          /* ä */ UNICODE(world_a_diaeresis_lower, <&kp N0 &kp N0 &kp E &kp N4>)

          /* Ä */ UNICODE(world_a_diaeresis_upper, <&kp N0 &kp N0 &kp C &kp N4>)

        world_a_diaeresis: world_a_diaeresis {
            compatible = "zmk,behavior-mod-morph";
            label = "WORLD_A_DIAERESIS";
            #binding-cells = <0>;
            bindings = <&world_a_diaeresis_lower>, <&world_a_diaeresis_upper>;
            mods = <MOD_LSFT>;
        };

          /* â */ UNICODE(world_a_circumflex_lower, <&kp N0 &kp N0 &kp E &kp N2>)

          /* Â */ UNICODE(world_a_circumflex_upper, <&kp N0 &kp N0 &kp C &kp N2>)

        world_a_circumflex: world_a_circumflex {
            compatible = "zmk,behavior-mod-morph";
            label = "WORLD_A_CIRCUMFLEX";
            #binding-cells = <0>;
            bindings = <&world_a_circumflex_lower>, <&world_a_circumflex_upper>;
            mods = <MOD_LSFT>;
        };

          /* à */ UNICODE(world_a_grave_lower, <&kp N0 &kp N0 &kp E &kp N0>)

          /* À */ UNICODE(world_a_grave_upper, <&kp N0 &kp N0 &kp C &kp N0>)

        world_a_grave: world_a_grave {
            compatible = "zmk,behavior-mod-morph";
            label = "WORLD_A_GRAVE";
            #binding-cells = <0>;
            bindings = <&world_a_grave_lower>, <&world_a_grave_upper>;
            mods = <MOD_LSFT>;
        };

          /* ã */ UNICODE(world_a_tilde_lower, <&kp N0 &kp N0 &kp E &kp N3>)

          /* Ã */ UNICODE(world_a_tilde_upper, <&kp N0 &kp N0 &kp C &kp N3>)

        world_a_tilde: world_a_tilde {
            compatible = "zmk,behavior-mod-morph";
            label = "WORLD_A_TILDE";
            #binding-cells = <0>;
            bindings = <&world_a_tilde_lower>, <&world_a_tilde_upper>;
            mods = <MOD_LSFT>;
        };

          /* å */ UNICODE(world_a_ring_lower, <&kp N0 &kp N0 &kp E &kp N5>)

          /* Å */ UNICODE(world_a_ring_upper, <&kp N0 &kp N0 &kp C &kp N5>)

        world_a_ring: world_a_ring {
            compatible = "zmk,behavior-mod-morph";
            label = "WORLD_A_RING";
            #binding-cells = <0>;
            bindings = <&world_a_ring_lower>, <&world_a_ring_upper>;
            mods = <MOD_LSFT>;
        };

          /* ý */ UNICODE(world_y_acute_lower, <&kp N0 &kp N0 &kp F &kp D>)

          /* Ý */ UNICODE(world_y_acute_upper, <&kp N0 &kp N0 &kp D &kp D>)

        world_y_acute: world_y_acute {
            compatible = "zmk,behavior-mod-morph";
            label = "WORLD_Y_ACUTE";
            #binding-cells = <0>;
            bindings = <&world_y_acute_lower>, <&world_y_acute_upper>;
            mods = <MOD_LSFT>;
        };

          /* ÿ */ UNICODE(world_y_diaeresis_lower, <&kp N0 &kp N0 &kp F &kp F>)

          /* Ÿ */ UNICODE(world_y_diaeresis_upper, <&kp N0 &kp N1 &kp N7 &kp N8>)

        world_y_diaeresis: world_y_diaeresis {
            compatible = "zmk,behavior-mod-morph";
            label = "WORLD_Y_DIAERESIS";
            #binding-cells = <0>;
            bindings = <&world_y_diaeresis_lower>, <&world_y_diaeresis_upper>;
            mods = <MOD_LSFT>;
        };

          /* ó */ UNICODE(world_o_acute_lower, <&kp N0 &kp N0 &kp F &kp N3>)

          /* Ó */ UNICODE(world_o_acute_upper, <&kp N0 &kp N0 &kp D &kp N3>)

        world_o_acute: world_o_acute {
            compatible = "zmk,behavior-mod-morph";
            label = "WORLD_O_ACUTE";
            #binding-cells = <0>;
            bindings = <&world_o_acute_lower>, <&world_o_acute_upper>;
            mods = <MOD_LSFT>;
        };

          /* ö */ UNICODE(world_o_diaeresis_lower, <&kp N0 &kp N0 &kp F &kp N6>)

          /* Ö */ UNICODE(world_o_diaeresis_upper, <&kp N0 &kp N0 &kp D &kp N6>)

        world_o_diaeresis: world_o_diaeresis {
            compatible = "zmk,behavior-mod-morph";
            label = "WORLD_O_DIAERESIS";
            #binding-cells = <0>;
            bindings = <&world_o_diaeresis_lower>, <&world_o_diaeresis_upper>;
            mods = <MOD_LSFT>;
        };

          /* ô */ UNICODE(world_o_circumflex_lower, <&kp N0 &kp N0 &kp F &kp N4>)

          /* Ô */ UNICODE(world_o_circumflex_upper, <&kp N0 &kp N0 &kp D &kp N4>)

        world_o_circumflex: world_o_circumflex {
            compatible = "zmk,behavior-mod-morph";
            label = "WORLD_O_CIRCUMFLEX";
            #binding-cells = <0>;
            bindings = <&world_o_circumflex_lower>, <&world_o_circumflex_upper>;
            mods = <MOD_LSFT>;
        };

          /* ò */ UNICODE(world_o_grave_lower, <&kp N0 &kp N0 &kp F &kp N2>)

          /* Ò */ UNICODE(world_o_grave_upper, <&kp N0 &kp N0 &kp D &kp N2>)

        world_o_grave: world_o_grave {
            compatible = "zmk,behavior-mod-morph";
            label = "WORLD_O_GRAVE";
            #binding-cells = <0>;
            bindings = <&world_o_grave_lower>, <&world_o_grave_upper>;
            mods = <MOD_LSFT>;
        };

          /* õ */ UNICODE(world_o_tilde_lower, <&kp N0 &kp N0 &kp F &kp N5>)

          /* Õ */ UNICODE(world_o_tilde_upper, <&kp N0 &kp N0 &kp D &kp N5>)

        world_o_tilde: world_o_tilde {
            compatible = "zmk,behavior-mod-morph";
            label = "WORLD_O_TILDE";
            #binding-cells = <0>;
            bindings = <&world_o_tilde_lower>, <&world_o_tilde_upper>;
            mods = <MOD_LSFT>;
        };

          /* ø */ UNICODE(world_o_slash_lower, <&kp N0 &kp N0 &kp F &kp N8>)

          /* Ø */ UNICODE(world_o_slash_upper, <&kp N0 &kp N0 &kp D &kp N8>)

        world_o_slash: world_o_slash {
            compatible = "zmk,behavior-mod-morph";
            label = "WORLD_O_SLASH";
            #binding-cells = <0>;
            bindings = <&world_o_slash_lower>, <&world_o_slash_upper>;
            mods = <MOD_LSFT>;
        };

          /* ú */ UNICODE(world_u_acute_lower, <&kp N0 &kp N0 &kp F &kp A>)

          /* Ú */ UNICODE(world_u_acute_upper, <&kp N0 &kp N0 &kp D &kp A>)

        world_u_acute: world_u_acute {
            compatible = "zmk,behavior-mod-morph";
            label = "WORLD_U_ACUTE";
            #binding-cells = <0>;
            bindings = <&world_u_acute_lower>, <&world_u_acute_upper>;
            mods = <MOD_LSFT>;
        };

          /* ü */ UNICODE(world_u_diaeresis_lower, <&kp N0 &kp N0 &kp F &kp C>)

          /* Ü */ UNICODE(world_u_diaeresis_upper, <&kp N0 &kp N0 &kp D &kp C>)

        world_u_diaeresis: world_u_diaeresis {
            compatible = "zmk,behavior-mod-morph";
            label = "WORLD_U_DIAERESIS";
            #binding-cells = <0>;
            bindings = <&world_u_diaeresis_lower>, <&world_u_diaeresis_upper>;
            mods = <MOD_LSFT>;
        };

          /* û */ UNICODE(world_u_circumflex_lower, <&kp N0 &kp N0 &kp F &kp B>)

          /* Û */ UNICODE(world_u_circumflex_upper, <&kp N0 &kp N0 &kp D &kp B>)

        world_u_circumflex: world_u_circumflex {
            compatible = "zmk,behavior-mod-morph";
            label = "WORLD_U_CIRCUMFLEX";
            #binding-cells = <0>;
            bindings = <&world_u_circumflex_lower>, <&world_u_circumflex_upper>;
            mods = <MOD_LSFT>;
        };

          /* ù */ UNICODE(world_u_grave_lower, <&kp N0 &kp N0 &kp F &kp N9>)

          /* Ù */ UNICODE(world_u_grave_upper, <&kp N0 &kp N0 &kp D &kp N9>)

        world_u_grave: world_u_grave {
            compatible = "zmk,behavior-mod-morph";
            label = "WORLD_U_GRAVE";
            #binding-cells = <0>;
            bindings = <&world_u_grave_lower>, <&world_u_grave_upper>;
            mods = <MOD_LSFT>;
        };

          /* ñ */ UNICODE(world_n_tilde_lower, <&kp N0 &kp N0 &kp F &kp N1>)

          /* Ñ */ UNICODE(world_n_tilde_upper, <&kp N0 &kp N0 &kp D &kp N1>)

        world_n_tilde: world_n_tilde {
            compatible = "zmk,behavior-mod-morph";
            label = "WORLD_N_TILDE";
            #binding-cells = <0>;
            bindings = <&world_n_tilde_lower>, <&world_n_tilde_upper>;
            mods = <MOD_LSFT>;
        };

      // transforms //////////////////////////////////////////////////////////

        world_i_base: world_i_base {
            compatible = "zmk,behavior-mod-morph";
            label = "WORLD_I_BASE";
            #binding-cells = <0>;
            bindings = <&world_i_acute>, <&world_i_LCTL>;
            mods = <(MOD_LCTL|MOD_RCTL|MOD_RSFT)>;
        };

        world_i_LCTL: world_i_LCTL {
            compatible = "zmk,behavior-mod-morph";
            label = "WORLD_I_LCTL";
            #binding-cells = <0>;
            bindings = <&world_i_diaeresis>, <&world_i_RCTL>;
            mods = <(MOD_RCTL|MOD_RSFT)>;
        };

        world_i_RCTL: world_i_RCTL {
            compatible = "zmk,behavior-mod-morph";
            label = "WORLD_I_RCTL";
            #binding-cells = <0>;
            bindings = <&world_i_circumflex>, <&world_i_grave>;
            mods = <(MOD_RSFT)>;
        };

        world_e_base: world_e_base {
            compatible = "zmk,behavior-mod-morph";
            label = "WORLD_E_BASE";
            #binding-cells = <0>;
            bindings = <&world_e_acute>, <&world_e_RALT>;
            mods = <(MOD_RALT|MOD_LCTL|MOD_RCTL|MOD_RSFT)>;
        };

        world_e_RALT: world_e_RALT {
            compatible = "zmk,behavior-mod-morph";
            label = "WORLD_E_RALT";
            #binding-cells = <0>;
            bindings = <&world_e_ae>, <&world_e_LCTL>;
            mods = <(MOD_LCTL|MOD_RCTL|MOD_RSFT)>;
        };

        world_e_LCTL: world_e_LCTL {
            compatible = "zmk,behavior-mod-morph";
            label = "WORLD_E_LCTL";
            #binding-cells = <0>;
            bindings = <&world_e_diaeresis>, <&world_e_RCTL>;
            mods = <(MOD_RCTL|MOD_RSFT)>;
        };

        world_e_RCTL: world_e_RCTL {
            compatible = "zmk,behavior-mod-morph";
            label = "WORLD_E_RCTL";
            #binding-cells = <0>;
            bindings = <&world_e_circumflex>, <&world_e_grave>;
            mods = <(MOD_RSFT)>;
        };

        world_a_base: world_a_base {
            compatible = "zmk,behavior-mod-morph";
            label = "WORLD_A_BASE";
            #binding-cells = <0>;
            bindings = <&world_a_acute>, <&world_a_LALT>;
            mods = <(MOD_LALT|MOD_RALT|MOD_LCTL|MOD_RCTL|MOD_RSFT)>;
        };

        world_a_LALT: world_a_LALT {
            compatible = "zmk,behavior-mod-morph";
            label = "WORLD_A_LALT";
            #binding-cells = <0>;
            bindings = <&world_a_tilde>, <&world_a_RALT>;
            mods = <(MOD_RALT|MOD_LCTL|MOD_RCTL|MOD_RSFT)>;
        };

        world_a_RALT: world_a_RALT {
            compatible = "zmk,behavior-mod-morph";
            label = "WORLD_A_RALT";
            #binding-cells = <0>;
            bindings = <&world_a_ring>, <&world_a_LCTL>;
            mods = <(MOD_LCTL|MOD_RCTL|MOD_RSFT)>;
        };

        world_a_LCTL: world_a_LCTL {
            compatible = "zmk,behavior-mod-morph";
            label = "WORLD_A_LCTL";
            #binding-cells = <0>;
            bindings = <&world_a_diaeresis>, <&world_a_RCTL>;
            mods = <(MOD_RCTL|MOD_RSFT)>;
        };

        world_a_RCTL: world_a_RCTL {
            compatible = "zmk,behavior-mod-morph";
            label = "WORLD_A_RCTL";
            #binding-cells = <0>;
            bindings = <&world_a_circumflex>, <&world_a_grave>;
            mods = <(MOD_RSFT)>;
        };

        world_y_base: world_y_base {
            compatible = "zmk,behavior-mod-morph";
            label = "WORLD_Y_BASE";
            #binding-cells = <0>;
            bindings = <&world_y_acute>, <&world_y_diaeresis>;
            mods = <(MOD_LCTL)>;
        };

        world_o_base: world_o_base {
            compatible = "zmk,behavior-mod-morph";
            label = "WORLD_O_BASE";
            #binding-cells = <0>;
            bindings = <&world_o_acute>, <&world_o_LALT>;
            mods = <(MOD_LALT|MOD_RALT|MOD_LCTL|MOD_RCTL|MOD_RSFT)>;
        };

        world_o_LALT: world_o_LALT {
            compatible = "zmk,behavior-mod-morph";
            label = "WORLD_O_LALT";
            #binding-cells = <0>;
            bindings = <&world_o_tilde>, <&world_o_RALT>;
            mods = <(MOD_RALT|MOD_LCTL|MOD_RCTL|MOD_RSFT)>;
        };

        world_o_RALT: world_o_RALT {
            compatible = "zmk,behavior-mod-morph";
            label = "WORLD_O_RALT";
            #binding-cells = <0>;
            bindings = <&world_o_slash>, <&world_o_LCTL>;
            mods = <(MOD_LCTL|MOD_RCTL|MOD_RSFT)>;
        };

        world_o_LCTL: world_o_LCTL {
            compatible = "zmk,behavior-mod-morph";
            label = "WORLD_O_LCTL";
            #binding-cells = <0>;
            bindings = <&world_o_diaeresis>, <&world_o_RCTL>;
            mods = <(MOD_RCTL|MOD_RSFT)>;
        };

        world_o_RCTL: world_o_RCTL {
            compatible = "zmk,behavior-mod-morph";
            label = "WORLD_O_RCTL";
            #binding-cells = <0>;
            bindings = <&world_o_circumflex>, <&world_o_grave>;
            mods = <(MOD_RSFT)>;
        };

        world_u_base: world_u_base {
            compatible = "zmk,behavior-mod-morph";
            label = "WORLD_U_BASE";
            #binding-cells = <0>;
            bindings = <&world_u_acute>, <&world_u_LCTL>;
            mods = <(MOD_LCTL|MOD_RCTL|MOD_RSFT)>;
        };

        world_u_LCTL: world_u_LCTL {
            compatible = "zmk,behavior-mod-morph";
            label = "WORLD_U_LCTL";
            #binding-cells = <0>;
            bindings = <&world_u_diaeresis>, <&world_u_RCTL>;
            mods = <(MOD_RCTL|MOD_RSFT)>;
        };

        world_u_RCTL: world_u_RCTL {
            compatible = "zmk,behavior-mod-morph";
            label = "WORLD_U_RCTL";
            #binding-cells = <0>;
            bindings = <&world_u_circumflex>, <&world_u_grave>;
            mods = <(MOD_RSFT)>;
        };

    //////////////////////////////////////////////////////////////////////////
    //
    // Emoji layer - modern age pictograms
    //
    //////////////////////////////////////////////////////////////////////////

          /* 🌑 */ UNICODE(emoji_new_moon, <&kp N1 &kp F &kp N3 &kp N1 &kp N1>)

          /* 🌒 */ UNICODE(emoji_waxing_crescent_moon, <&kp N1 &kp F &kp N3 &kp N1 &kp N2>)

          /* 🌓 */ UNICODE(emoji_first_quarter_moon, <&kp N1 &kp F &kp N3 &kp N1 &kp N3>)

          /* 🌔 */ UNICODE(emoji_waxing_gibbous_moon, <&kp N1 &kp F &kp N3 &kp N1 &kp N4>)

          /* 🌕 */ UNICODE(emoji_full_moon, <&kp N1 &kp F &kp N3 &kp N1 &kp N5>)

          /* 🎉 */ UNICODE(emoji_tada, <&kp N1 &kp F &kp N3 &kp N8 &kp N9>)

          /* ️❤️ */ UNICODE_SEQUENCE(emoji_heart, <&macro_wait_time UNICODE_SEQ_DELAY>, UNICODE_TRANSLATE(<&kp F &kp E &kp N0 &kp F>), UNICODE_TRANSLATE(<&kp N2 &kp N7 &kp N6 &kp N4>), UNICODE_TRANSLATE(<&kp F &kp E &kp N0 &kp F>))

          /* 🔥 */ UNICODE(emoji_fire, <&kp N1 &kp F &kp N5 &kp N2 &kp N5>)

          /* 💪 */ UNICODE(emoji_muscle, <&kp N1 &kp F &kp N4 &kp A &kp A>)

          /* 🧗 */ UNICODE(emoji_person_climbing, <&kp N1 &kp F &kp N9 &kp D &kp N7>)

          /* 🚀 */ UNICODE(emoji_rocket, <&kp N1 &kp F &kp N6 &kp N8 &kp N0>)

          /* 😎 */ UNICODE(emoji_sunglasses, <&kp N1 &kp F &kp N6 &kp N0 &kp E>)

          /* 😍 */ UNICODE(emoji_heart_eyes, <&kp N1 &kp F &kp N6 &kp N0 &kp D>)

          /* 🤩 */ UNICODE(emoji_star_struck, <&kp N1 &kp F &kp N9 &kp N2 &kp N9>)

          /* 🥲 */ UNICODE(emoji_tear_smile, <&kp N1 &kp F &kp N9 &kp N7 &kp N2>)

          /* 😱 */ UNICODE(emoji_scream, <&kp N1 &kp F &kp N6 &kp N3 &kp N1>)

          /* 🧑‍🚀 */ UNICODE_SEQUENCE(emoji_astronaut, <&macro_wait_time UNICODE_SEQ_DELAY>, UNICODE_TRANSLATE(<&kp N1 &kp F &kp N9 &kp D &kp N1>), UNICODE_TRANSLATE(<&kp N2 &kp N0 &kp N0 &kp D>), UNICODE_TRANSLATE(<&kp N1 &kp F &kp N6 &kp N8 &kp N0>))

          /* 🫰 */ UNICODE(emoji_snap_fingers, <&kp N1 &kp F &kp A &kp F &kp N0>)

          /* 👌 */ UNICODE(emoji_ok_hand, <&kp N1 &kp F &kp N4 &kp N4 &kp C>)

          /* 🙏 */ UNICODE(emoji_pray, <&kp N1 &kp F &kp N6 &kp N4 &kp F>)

          /* 😅 */ UNICODE(emoji_sweat_smile, <&kp N1 &kp F &kp N6 &kp N0 &kp N5>)

          /* 😰 */ UNICODE(emoji_cold_sweat, <&kp N1 &kp F &kp N6 &kp N3 &kp N0>)

          /* 🤯 */ UNICODE(emoji_exploding_head, <&kp N1 &kp F &kp N9 &kp N2 &kp F>)

          /* 💁 */ UNICODE(emoji_person_tipping_hand, <&kp N1 &kp F &kp N4 &kp N8 &kp N1>)

          /* 🙆 */ UNICODE(emoji_person_gesturing_ok, <&kp N1 &kp F &kp N6 &kp N4 &kp N6>)

          /* 🙇 */ UNICODE(emoji_person_bowing, <&kp N1 &kp F &kp N6 &kp N4 &kp N7>)

          /* 🙋 */ UNICODE(emoji_person_raising_hand, <&kp N1 &kp F &kp N6 &kp N4 &kp B>)

          /* 🙅 */ UNICODE(emoji_person_gesturing_no, <&kp N1 &kp F &kp N6 &kp N4 &kp N5>)

          /* 🤷 */ UNICODE(emoji_person_shrugging, <&kp N1 &kp F &kp N9 &kp N3 &kp N7>)

          /* ✅ */ UNICODE(emoji_checkoff, <&kp N2 &kp N7 &kp N0 &kp N5>)

          /* 💯 */ UNICODE(emoji_100, <&kp N1 &kp F &kp N4 &kp A &kp F>)

          /* ⚠️ */ UNICODE_SEQUENCE(emoji_warning, <&macro_wait_time UNICODE_SEQ_DELAY>, UNICODE_TRANSLATE(<&kp N2 &kp N6 &kp A &kp N0>), UNICODE_TRANSLATE(<&kp F &kp E &kp N0 &kp F>))

          /* ❌ */ UNICODE(emoji_x, <&kp N2 &kp N7 &kp N4 &kp C>)

          /* ❓ */ UNICODE(emoji_question, <&kp N2 &kp N7 &kp N5 &kp N3>)

          /* 🤓 */ UNICODE(emoji_nerd, <&kp N1 &kp F &kp N9 &kp N1 &kp N3>)

          /* 🙌 */ UNICODE(emoji_raised_hands, <&kp N1 &kp F &kp N6 &kp N4 &kp C>)

          /* ✨ */ UNICODE(emoji_sparkles, <&kp N2 &kp N7 &kp N2 &kp N8>)

          /* 🤔 */ UNICODE(emoji_thinking, <&kp N1 &kp F &kp N9 &kp N1 &kp N4>)

          /* 👎 */ UNICODE(emoji_thumbs_down, <&kp N1 &kp F &kp N4 &kp N4 &kp E>)

          /* 👍 */ UNICODE(emoji_thumbs_up, <&kp N1 &kp F &kp N4 &kp N4 &kp D>)

};
